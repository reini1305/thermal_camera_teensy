/***************************************************************************
  This is a library for the AMG88xx GridEYE 8x8 IR camera

  This sketch makes an inetrpolated pixel thermal camera with the 
  GridEYE sensor and a 2.4" tft featherwing:
	 https://www.adafruit.com/product/3315

  Designed specifically to work with the Adafruit AMG8833 Featherwing
          https://www.adafruit.com/product/3622

  These sensors use I2C to communicate. The device's I2C address is 0x69

  Adafruit invests time and resources providing this open source code,
  please support Adafruit andopen-source hardware by purchasing products
  from Adafruit!

  Written by Dean Miller, James DeVito & ladyada for Adafruit Industries.
  BSD license, all text above must be included in any redistribution
 ***************************************************************************/
#include <SD.h>
#include <SPI.h>
#include <TFT.h>

#include <Wire.h>
#include <Adafruit_AMG88xx.h>

#include <EEPROM.h>

// pin definitions
#define cs   10
#define dc   9
#define rst  8
#define cs_sd 7
#define input 6

TFT tft = TFT(cs, dc, rst);


//low range of the sensor (this will be blue on the screen)
#define MINTEMP 0

//high range of the sensor (this will be red on the screen)
#define MAXTEMP 800

//jet
uint16_t jet[] = {0x480F,
0x400F,0x400F,0x400F,0x4010,0x3810,0x3810,0x3810,0x3810,0x3010,0x3010,
0x3010,0x2810,0x2810,0x2810,0x2810,0x2010,0x2010,0x2010,0x1810,0x1810,
0x1811,0x1811,0x1011,0x1011,0x1011,0x0811,0x0811,0x0811,0x0011,0x0011,
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0xF080,0xF060,0xF040,0xF020,0xF800,};

//plasma
uint16_t plasma[] = {0x0830,0x0830,0x1030,0x1030,0x1030,0x1831,0x1831,0x1831,0x2031,0x2031,0x2031,0x2031,0x2831,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0xEFA4,};

uint16_t *camColors;

Adafruit_AMG88xx amg;

#define AMG_COLS 8
#define AMG_ROWS 8
uint16_t pixels[AMG_COLS * AMG_ROWS];

#define INTERPOLATED_COLS 21
#define INTERPOLATED_ROWS 21
#define TEXT_X            32
#define TEXT_Y            64

#define LIVE_MODE         0
#define SD_MODE           1

uint16_t dest_2d[INTERPOLATED_ROWS * INTERPOLATED_COLS];
uint16_t boxsize;
uint16_t fileNumberWrite = 0;
uint16_t fileNumberRead = 0; 
uint16_t minTemp = 0;
uint16_t maxTemp = 0; 
unsigned long lastWrite = 0;
bool buttonPressed = false;
uint8_t colorMapId = 0;
uint8_t mode = LIVE_MODE;

uint16_t get_point(uint16_t *p, uint8_t rows, uint8_t cols, int8_t x, int8_t y);
void interpolate_image(uint16_t *src, uint8_t src_rows, uint8_t src_cols, 
                       uint16_t *dest, uint8_t dest_rows, uint8_t dest_cols);

void handleButtonPress(void) {
  buttonPressed = true;
}

void setup() {
  //setup tft
  tft.begin();
  //tft.setRotation(3);
  tft.fillScreen(0);
  tft.stroke(255,255,255);
  tft.setTextSize(1);
  
  // setup sd card
  SD.begin(cs_sd);

  EEPROM.get(0,fileNumberWrite);
  EEPROM.get(sizeof(uint16_t),colorMapId);
  fileNumberRead = fileNumberWrite - 1;
  if(colorMapId == 0) {
    camColors = plasma;
    colorMapId = 1;
  }
  else {
    camColors = jet;
    colorMapId = 0;
  }
  EEPROM.put(sizeof(uint16_t),colorMapId);
  drawLegend();
  boxsize = min(tft.width() / INTERPOLATED_COLS, tft.height() / INTERPOLATED_COLS);
  
  // setup temperature sensor
  if(amg.begin()) {
    amg.readPixels(pixels);
  }
  
  pinMode(input,INPUT_PULLUP);
  attachInterrupt(input,handleButtonPress,FALLING);

  // Check the mode (button pressed: read images from sd card)
  if(digitalRead(input) == 0)
    mode = SD_MODE;
}

void loop() {
  //read all the pixels
  //readPixels();
  if (mode == LIVE_MODE) {
    amg.readPixels(pixels);
    updateMinMax();
    interpolate_image(pixels, AMG_ROWS, AMG_COLS, dest_2d, INTERPOLATED_ROWS, INTERPOLATED_COLS);
    drawpixels(dest_2d, INTERPOLATED_ROWS, INTERPOLATED_COLS, boxsize, boxsize);
    if (buttonPressed) {
      saveFile();
      buttonPressed = false;
    }
  } else {
    if (buttonPressed) {
      loadNextFile();
      updateMinMax();
      interpolate_image(pixels, AMG_ROWS, AMG_COLS, dest_2d, INTERPOLATED_ROWS, INTERPOLATED_COLS);
      drawpixels(dest_2d, INTERPOLATED_ROWS, INTERPOLATED_COLS, boxsize, boxsize);
      char filename[10];
      sprintf(filename,"%05d.raw",fileNumberRead + 1);
      tft.text(filename,TEXT_X,TEXT_Y);
      buttonPressed = false;
    }
  }
}

void drawLegend(void)
{
  for (unsigned char y=16;y<tft.height()-16;y++) {
    uint8_t colorIndex = map(y,16,tft.height()-16,0,255);
    tft.drawLine(tft.width()-24,y,tft.width()-8,y,camColors[colorIndex]);
  }
}

void readPixels(void)
{
  for (unsigned int i=0; i< AMG_COLS * AMG_ROWS; i++)
    pixels[i] = (random(MINTEMP, MAXTEMP));
}

void updateMinMax(void) {
  uint16_t newMin = 1000;
  uint16_t newMax = 0;
  for (unsigned int i=0; i< AMG_COLS * AMG_ROWS; i++) {
    newMin = min(newMin,pixels[i]);
    newMax = max(newMax,pixels[i]);
  }
  
  // update legend
  char buffer[6];
  if (newMax/10 != maxTemp/10) {
    maxTemp = newMax;
    tft.fillRect(tft.width()-28, tft.height()-8, 28, 8, 0);
    sprintf(buffer,"%d C",(maxTemp/10));
    tft.text(buffer, tft.width()-28, tft.height()-8);
  }
  if (newMin/10 != minTemp/10) {
    minTemp = newMin;
    tft.fillRect(tft.width()-28, 0, 28, 8, 0);
    sprintf(buffer,"%d C",(minTemp/10));
    tft.text(buffer, tft.width()-28, 0);
  }
}

void saveFile(void) {
  // only allow taking images every two seconds
  if ((millis() - lastWrite) > 2000) {
    lastWrite = millis();
    char filename[10];
    sprintf(filename,"%05d.raw",fileNumberWrite);
    File myFile = SD.open(filename, FILE_WRITE);
    tft.fillRect(TEXT_X,TEXT_Y,54,8,0);
    if(myFile) {
      myFile.write((uint8_t *)pixels,AMG_ROWS*AMG_COLS*sizeof(uint16_t));
      //myFile.print(42);
      myFile.flush();
      myFile.close();
      fileNumberWrite++;
      EEPROM.put(0,fileNumberWrite);
      tft.text(filename,TEXT_X,TEXT_Y);
    } else {
      tft.text("!!Error!!",TEXT_X,TEXT_Y);
    }
    delay(1000);
  } 
}

void loadNextFile(void) {
  // only allow reading images every seconds
  if ((millis() - lastWrite) > 1000) {
    lastWrite = millis();
    char filename[10];
    sprintf(filename,"%05d.raw",fileNumberRead--);
    File myFile = SD.open(filename, FILE_READ);
    if (myFile == 0) { // we have arrived at a file that is not on the card anymore
      fileNumberRead = fileNumberWrite - 1;  // reset filenumber
      sprintf(filename,"%05d.raw",fileNumberRead--);
      myFile = SD.open(filename, FILE_READ);
    }
    myFile.read((uint8_t *)pixels,AMG_ROWS*AMG_COLS*sizeof(uint16_t));
    myFile.close();
  }
}

void drawpixels(uint16_t *p, uint8_t rows, uint8_t cols, uint8_t boxWidth, uint8_t boxHeight) {
  for (int y=0; y<rows; y++) {
    for (int x=0; x<cols; x++) {
      uint16_t val = constrain(get_point(p, rows, cols, x, y),minTemp,maxTemp);
      
      uint8_t colorIndex = map(val, minTemp, maxTemp, 0, 255);
      //draw the pixels!
      tft.fillRect(boxWidth * x, boxHeight * y, boxWidth, boxHeight, camColors[colorIndex]);
    } 
  }
}
